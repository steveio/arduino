/* 
   OLED LCD 128*32 - Sine Wave Plots

   Unbuffered graphics & character display routines using SH1106 I2C Wire Interface

   Based on -
   Tiny Function Plotter (SH1106 version) - see http://www.technoblogy.com/show?2CFT   
   CC BY 4.0
   Licensed under a Creative Commons Attribution 4.0 International license: 
   http://creativecommons.org/licenses/by/4.0/
*/

#include <Wire.h>

// Constants
int const address = 60;
int const commands = 0x00;
int const onecommand = 0x80;
int const data = 0x40;
int const onedata = 0xC0;

// OLED display **********************************************

// Current plot position
int x0;
int y0;

// Character set for text - stored in program memory
const uint8_t CharMap[96][6] PROGMEM = {
{ 0x00, 0x00, 0x00, 0x00, 0x00, 0x00 }, 
{ 0x00, 0x00, 0x5F, 0x00, 0x00, 0x00 }, 
{ 0x00, 0x07, 0x00, 0x07, 0x00, 0x00 }, 
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{ 0xFF, 0xFF, 0xFF, 0xFF, 0xFF, 0x00 }

};

// Initialisation sequence for OLED module

int const InitLen = 2;
const uint8_t Init[InitLen] PROGMEM = {
  0xA1, // Flip horizontally
  0xAF  // Display on
};

void InitDisplay () {
  Wire.beginTransmission(address);
  Wire.write(commands);
  for (uint8_t i=0; i<InitLen; i++) Wire.write(pgm_read_byte(&Init[i]));
  Wire.endTransmission();
}

// Plot point (SH1106): x (0 to 127), y (0 to 63), mode (0 = point, 1 = histogram)
void PlotPoint (int x, int y, int mode) {
  x = x + 2;
  for (int i=0; i<8; i++) {
    Wire.beginTransmission(address);
    Wire.write(onecommand);
    Wire.write(0x00 + (x & 0x0F));                 // Column low nibble
    Wire.write(onecommand);
    Wire.write(0x10 + (x>>4 & 0x0F));              // Column high nibble
    Wire.write(onecommand);
    Wire.write(0xB0 | i);                          // Page
    Wire.write(onedata);
    if (y > 7) Wire.write(- mode);
    else if (y < 0) Wire.write(0);
    else Wire.write((1<<y) - mode);
    y = y - 8;
    Wire.endTransmission();
  }
}

uint8_t ReverseByte (uint8_t x) {
  x = ((x >> 1) & 0x55) | ((x << 1) & 0xaa);
  x = ((x >> 2) & 0x33) | ((x << 2) & 0xcc);
  x = ((x >> 4) & 0x0f) | ((x << 4) & 0xf0);
  return x;    
}

void Single (uint8_t x) {
  Wire.write(onecommand);
  Wire.write(x);
}

void PlotChar (int c, int x, int y) {
  int h = y & 0x07;
  for (int p = 0; p < 1; p++) {
    Wire.beginTransmission(address);
    Single(0xB0 + (y >> 3) + p);          // Page
    for (int col=0; col<6; col++) {
      Single(0x00 + ((x+2+col) & 0x0F));  // Column low nibble
      Single(0x10 + ((x+2+col)>>4));      // Column high nibble
      Single(0xE0);                       // Read modify write
      Wire.write(onedata);
      Wire.endTransmission();
      Wire.requestFrom(address, 2);
      Wire.read();                        // Dummy read
      int j = Wire.read();
      Wire.beginTransmission(address);
      Wire.write(onedata);
      int bits = ReverseByte(pgm_read_byte(&CharMap[c-32][col]));
      Wire.write(bits);
      Single(0xEE);                       // Cancel read modify write
    }
    Wire.endTransmission();
  }
}

void PlotText(PGM_P s) {
  int p = (int)s;
  while (1) {
    char c = pgm_read_byte(p++);
    if (c == 0) return;
    PlotChar(c, x0, y0);
    x0 = x0 + 6;
  }
}

void ClearDisplay () {
  for (int x=0; x<128; x++) PlotPoint(x, 0, 1);
}

/*
void ClearDisplay () {
  for (int p = 0 ; p < 8; p++) {
    Wire.beginTransmission(address);
    Single(0xB0 + p);
    Wire.endTransmission();
    for (int q = 0 ; q < 8; q++) {
      Wire.beginTransmission(address);
      Wire.write(data);
      for (int i = 0 ; i < 20; i++) Wire.write(0);
      Wire.endTransmission();
    }
  }
}
*/

void MoveTo (int x, int y) {
  x0 = x;
  y0 = y;
}

// Setup **********************************************

void setup() {
  Serial.begin(115200);
  Wire.begin();
  InitDisplay();
  ClearDisplay();
}

// Gaussian approximation
int e (int x, int f, int m) {
  return (f * 256) / (256 + ((x - m) * (x - m)));
}


// Demo plot
void loop () {

  ClearDisplay();

  MoveTo(0, 16); PlotText(PSTR("Sine Wave"));

  delay(200);

  MoveTo(0, 0); PlotText(PSTR("a sin((x-h)/b)+k"));

  delay(2000);

  float a = random(4,16);
  float h = random(2,8    );
  float b = random(4,12); // 6;
  float k = a + random(0,4);

  for (float i=0; i<8; i++) {
    for (float x=0; x<128; x++) {
      //int y = e(x, 40, 24) + e(x, 68, 64) + e(x, 30, 104) - 24;
  
      float y = a * sin((x+i-h)/b)+k;
  
      PlotPoint(x, y, 0);
    }
  }

  delay(100);
  //for (;;);
}
